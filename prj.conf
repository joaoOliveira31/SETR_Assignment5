## CMakeLists.txt
```
# SPDX-License-Identifier: Apache-2.0

cmake_minimum_required(VERSION 3.20.0)
find_package(Zephyr REQUIRED HINTS $ENV{ZEPHYR_BASE})
project(SETR_Assignment5)

target_sources(app PRIVATE src/main.c)
target_sources(app PRIVATE src/adc.c)
target_sources(app PRIVATE src/PWM.c)
target_sources(app PRIVATE src/Filter.c)
target_sources(app PRIVATE src/Placa.c)
```

## prj.conf
```kconfig
CONFIG_PRINTK=y
CONFIG_HEAP_MEM_POOL_SIZE=256
CONFIG_ASSERT=y
CONFIG_GPIO=y
CONFIG_PWM=y
CONFIG_ADC=y
CONFIG_ADC_ASYNC=y
CONFIG_TIMING_FUNCTIONS=y
CONFIG_USE_SEGGER_RTT=n
CONFIG_RTT_CONSOLE=n
CONFIG_UART_CONSOLE=y
CONFIG_CONSOLE_SUBSYS=y
CONFIG_CONSOLE_GETCHAR=y
CONFIG_CONSOLE_GETCHAR_BUFSIZE=64
CONFIG_CONSOLE_PUTCHAR_BUFSIZE=512
```

## src/main.c
```c
/** \file main.c
* \brief The system does a basic processing of an analog signal. It reads the input voltage
from an analog sensor, digitally filters the signal and outputs it.
*
* The system toogles the duty cycle os the pwm signal that is connected to the LED1(output) in function of the concurrent voltage os the 
*potenciometer(input). The information is shared between the treads using Semaphores and Shared Memory
* 
*
* \author Goncalo Moniz, Joao Oliveira, Diogo Leao
* \date 31-5-2022
* \bug There are no bugs
*/

/**
@mainpage ASSIGNMENT 4 PART 1
@author Goncalo Moniz, Joao Oliveira, Diogo Leao

The aim of this assignment is to learn how to implement a set of cooperative real-time tasks in
Zephyr. Replicating the typical structure of embedded software, a mix of periodic and sporadic
tasks will be considered.

The system to implement does a basic processing of an analog signal. It reads the input voltage
from an analog sensor, digitally filters the signal and outputs it.

. Input sensor: Emulated by a 10 kO potentiometer, supplied by the DevKit 3 V supply
(VDD).

. Digital filter: moving average filter, with a window size of 10 samples. Removes the
outliers (10% or high deviation from average) and computes the average of the remaining
samples. 

. Output: pwm signal applied to one of the DevKit leds.

The system shall be structured with at least three tasks, matching the basic processing blocks,
namely one task for acquiring the sample, one for filtering and the other to output the signal.
The sampling task is periodic, while the other two are sporadic, being activated when new data is
available.


*/
#include <zephyr.h>
#include <device.h>
#include <drivers/gpio.h>
#include <drivers/adc.h>
#include <string.h>
#include <devicetree.h>
#include <sys/printk.h>
#include <sys/__assert.h>
#include <timing/timing.h>
#include <stdio.h>
#include <sys/printk.h>
#include <hal/nrf_saadc.h>
#include "ADC.h"
#include "Filter.h"
#include "PWM.h"
#include "Placa.h"



//----------------THREAD CONFIG


/* Size of stack area used by each thread (can be thread specific, if necessary)*/
#define STACK_SIZE 1024
/* Thread scheduling priority */
#define thread_A_prio 1
#define thread_B_prio 1
#define thread_C_prio 1
#define thread_D_prio 1
/* Create thread stack space */
K_THREAD_STACK_DEFINE(thread_A_stack, STACK_SIZE);
K_THREAD_STACK_DEFINE(thread_B_stack, STACK_SIZE);
K_THREAD_STACK_DEFINE(thread_C_stack, STACK_SIZE);
K_THREAD_STACK_DEFINE(thread_D_stack, STACK_SIZE);
/* Create variables for thread data */
struct k_thread thread_A_data;
struct k_thread thread_B_data;
struct k_thread thread_C_data;
struct k_thread thread_D_data;
/* Create task IDs */
k_tid_t thread_A_tid;
k_tid_t thread_B_tid;
k_tid_t thread_C_tid;
k_tid_t thread_D_tid;
/* Thread code prototypes */
void thread_A_code(void *, void *, void *);
void thread_B_code(void *, void *, void *);
void thread_C_code(void *, void *, void *);
void thread_D_code(void *, void *, void *);





//------------------SEMS CONFIG + SHARED MEMORY


struct k_sem sem_ab;
struct k_sem sem_cd;
/** Shared memory betwen ADC and Filter.
 */ 
uint16_t ab;
/** Shared memory betwen Fiter and PWM.
 */ 
uint16_t bc;
/** Shared memory betwen buttons and PWM.
 */ 
uint16_t cd;
uint8_t c;
//----------------MAIN

/**brief Main function
* 
* Inicialization of Semaphores and Threads
* 
* \author Goncalo Moniz, Joao Oliveira, Diogo Leao
* \param[in,out] 
*void
*void
* \return void
* \date 31-5-2022
*/
void main(void)
{

    /* Create/Init Semaphores */
    k_sem_init(&sem_ab,0,1);
    k_sem_init(&sem_cd,0,1);
    /* Then create the task */
    thread_A_tid = k_thread_create(&thread_A_data, thread_A_stack,
    K_THREAD_STACK_SIZEOF(thread_A_stack), thread_A_code,
    NULL, NULL, NULL, thread_A_prio, 0, K_NO_WAIT);

    thread_B_tid = k_thread_create(&thread_B_data, thread_B_stack,
    K_THREAD_STACK_SIZEOF(thread_B_stack), thread_B_code,
    NULL, NULL, NULL, thread_B_prio, 0, K_NO_WAIT);

    thread_C_tid = k_thread_create(&thread_C_data, thread_C_stack,
    K_THREAD_STACK_SIZEOF(thread_C_stack), thread_C_code,
    NULL, NULL, NULL, thread_C_prio, 0, K_NO_WAIT);

    thread_D_tid = k_thread_create(&thread_D_data, thread_D_stack,
    K_THREAD_STACK_SIZEOF(thread_D_stack), thread_D_code,
    NULL, NULL, NULL, thread_D_prio, 0, K_NO_WAIT);

     
}
```

## src/ADC.c
```c
#include "ADC.h"

/* ADC channel configuration */
static const struct adc_channel_cfg my_channel_cfg = {
	.gain = ADC_GAIN,
	.reference = ADC_REFERENCE,
	.acquisition_time = ADC_ACQUISITION_TIME,
	.channel_id = ADC_CHANNEL_ID,
    .input_positive = ADC_CHANNEL_INPUT
};

/* Global vars */
struct k_timer my_timer;
const struct device *adc_dev = NULL;
static uint16_t adc_sample_buffer[BUFFER_SIZE];

/* Takes one sample */
static int adc_sample(void) 
{
	int ret;
	const struct adc_sequence sequence = {
		.channels = BIT(ADC_CHANNEL_ID),
		.buffer = adc_sample_buffer,
		.buffer_size = sizeof(adc_sample_buffer),
		.resolution = ADC_RESOLUTION,
	};

	if (adc_dev == NULL) {
            printk("adc_sample(): error, must bind to adc first \n\r");
            return -1;
	}

	ret = adc_read(adc_dev, &sequence);
	if (ret) {
            printk("adc_read() failed with code %d\n", ret);
	}	

	return ret;
}

void thread_A_code(void *argA , void *argB, void *argC)
{
 
    /* Local vars */
    int64_t fin_time=0, release_time=0;     /* Timing variables to control task periodicity */    
                        
    int err=0;
    /* Task init code */
    printk("Thread A init (periodic)\n");

    /* Compute next release instant */
    release_time = k_uptime_get() + SAMP_PERIOD_MS;
    
  /* ADC setup: bind and initialize */
    adc_dev = device_get_binding(DT_LABEL(ADC_NID));
	if (!adc_dev) {
        printk("ADC device_get_binding() failed\n");
    } 
    err = adc_channel_setup(adc_dev, &my_channel_cfg);
    if (err) {
        printk("adc_channel_setup() failed with error code %d\n", err);
    }
    
    /* It is recommended to calibrate the SAADC at least once before use, and whenever the ambient temperature has changed by more than 10 Â°C */
    NRF_SAADC->TASKS_CALIBRATEOFFSET = 1;


    /* Thread loop */
    /* Main loop */
    while(true)
    {
        /* Get one sample, checks for errors and prints the values */
        err=adc_sample();
        if(err) {
            printk("adc_sample() failed with error code %d\n\r",err);
        }
        else {
            if(adc_sample_buffer[0] > 1023) {
                //printk("adc reading out of range\n\r");
            }
            else {
                /* ADC is set to use gain of 1/4 and reference VDD/4, so input range is 0...VDD (3 V), with 10 bit resolution */
                ab = adc_sample_buffer[0];
                //printk("adc reading: raw:%4u / %4u mV: \n\r",adc_sample_buffer[0],(uint16_t)(1000*adc_sample_buffer[0]*((float)3/1023)));
            }
        }

        k_sem_give(&sem_ab);
  
        /* Wait for next release instant */ 
        fin_time = k_uptime_get();
        if( fin_time < release_time) 
        {
            k_msleep(release_time - fin_time);
            release_time += SAMP_PERIOD_MS;
        }

        /* Stop timing functions */
        timing_stop();
        }    
 }
```

## src/ADC.h
```c
/** \file ADC.h
* \brief ADC Input Sensor
* 
* Process the input signal using an adc
* Input sensor: Emulated by a 10 kO potentiometer, supplied by the DevKit 3 V supply(VDD).
* 
* \author Goncalo Moniz, Joao Oliveira, Diogo Leao
* \date 31-5-2022
* \bug There are no bugs
*/

#include <zephyr.h>
#include <device.h>
#include <drivers/gpio.h>
#include <drivers/adc.h>
#include <string.h>
#include <devicetree.h>
#include <sys/printk.h>
#include <sys/__assert.h>
#include <timing/timing.h>
#include <stdio.h>
#include <sys/printk.h>
#include <hal/nrf_saadc.h>

#ifndef _ADC_H
#define _ADC_H

/** Sampling Period
*/
#define SAMP_PERIOD_MS 10


#define ADC_NID DT_NODELABEL(adc) 
#define ADC_RESOLUTION 10
#define ADC_GAIN ADC_GAIN_1_4
#define ADC_REFERENCE ADC_REF_VDD_1_4
#define ADC_ACQUISITION_TIME ADC_ACQ_TIME(ADC_ACQ_TIME_MICROSECONDS, 40)
#define ADC_CHANNEL_ID 1  

//-----------------ADC CONFIG

#define ADC_CHANNEL_INPUT NRF_SAADC_INPUT_AIN1 
#define BUFFER_SIZE 1
#define TIMER_INTERVAL_MSEC 50 /* Interval between ADC samples */

extern uint16_t ab;
extern struct k_sem sem_ab;

/**Thread A 
* 
* Thread for the ADC
* \author Goncalo Moniz, Joao Oliveira, Diogo Leao
* \param[in,out] 
*void
*void
* \return void
* \date 31-5-2022
*/
void thread_A_code(void *argA , void *argB, void *argC);

#endif
```

## src/Filter.c
```c
#include "Filter.h"

void thread_B_code(void *argA , void *argB, void *argC)
{
    /* Local variables */
    uint16_t array[10],soma=0,media=0,media2=0,lim=0;
    int cnt=0;
    int cnt2=0;
    printk("Thread B init (sporadic, waits on a semaphore by task A)\n");
    while(1) {
        k_sem_take(&sem_ab, K_FOREVER);
        //filtro
       
       if(cnt<10)//encher
       {
         array[cnt]=ab;
         cnt++;
       }

       else
       {
           for(int i = 9 ; i > 0 ; i--)
           {
              array[i] = array[i-1];
           }
           array[0] = ab;

           for(int i=0;i<10;i++){//soma
              soma+=array[i];
           }
           //printk("Soma = %4u\n",soma);
           media=soma/10;//media 
           //printk("Media = %4u\n",media); 
               
       
           lim = media/10;
       
           for(int i=0;i<10;i++)
           {
              if((array[i] < (media-lim)) || (array[i] > (media+lim)))
              {
                soma = soma - array[i];
                cnt2++;
              }
           }
          
     }
     if(cnt2 == 10)
      media2 = media;
     else
      media2 = soma /(10-cnt2);
     bc = media2;//data_ab->data;
     soma=0;
     cnt2=0;
       
  }
}
```

## src/Filter.h
```c
/** \file Filter.h
* \brief Digital Filter
* 
* Process the data from the tread A using a filter 
* Digital filter: moving average filter, with a window size of 10 samples. Removes the
* outliers (10% or high deviation from average) and computes the average of the remaining
* samples.
*
* \author Goncalo Moniz, Joao Oliveira, Diogo Leao
* \date 31-5-2022
* \bug There are no bugs
*/

#include <zephyr.h>
#include <device.h>
#include <drivers/uart.h>
#include <stdlib.h>
#include <stdio.h>
#include <string.h>

#ifndef _FILTER_H
#define _FILTER_H

extern uint16_t ab,bc;

extern struct k_sem sem_ab;


/**Thread B 
* 
* Thread for the Filter
* \author Goncalo Moniz, Joao Oliveira, Diogo Leao
* \param[in,out] 
* void
* void
* \return void
* \date 31-5-2022
*/
void thread_B_code(void *argA , void *argB, void *argC);

#endif
```

## src/PWM.c
```c
#include "PWM.h"
#include <zephyr.h>
#include <device.h>
#include <drivers/gpio.h>
#include <string.h>
#include <console/console.h>
#include <stdlib.h>
#include <stdio.h>

/* global variables */
int hour,seg,min,min1,min2,hora,hora1,hora2,day1,day2,lux=0;
int day=1;
int dayOn[]={0,0,0,0,0,0,0,0,0,0,0,0,0,0};
int horasOn[]={0,0,0,0,0,0,0,0,0,0,0,0,0,0};
int arrLen = sizeof dayOn / sizeof dayOn[0];
int temp;

/* Funcao do relogio */
void clkPrint(){
  
  hour++;
  if(hour%10==0)
  {
      seg++;
  }
  if(seg==60)
  {  
      min++;
      seg=0;
     
  }
  if(min==60)
  {
     hora++;
     min=0;
     seg=0;
  }
  if(hora==24)
  {
      hour=0;
      hora=0;
      seg=0;
      min=0;
      day++;
  }
  if(day==31 && hora>=23 )
  {
    day=1;  
  }
}
       
void thread_C_code(void *argA , void *argB, void *argC)
{
    
    /* Local variables */
    int ret=0;      
    int duty=100;
    int16_t Ti,Td, kp, saidaPI=0, ref=0,ref1=0,ref2=0,ref3=0,ref4=0;
    int16_t integ=0,diff=0;
    int16_t erro,erro2=0;
    ref=1500,ref1=1500, ref2=1500,ref3=1500,ref4=1500;    
    int tensaoMV=0;
    int tensaoambiente;
    int to_add;
    int total=0;
    int flag=0,flag1=0;
    int mode = 1;
    const struct device *gpio0_dev;         /* Pointer to GPIO device structure */
    const struct device *pwm0_dev;          /* Pointer to PWM device structure */
    unsigned int pwmPeriod_us = 1000;       /* PWM priod in us */
    uint8_t c;
    console_init();
    
    /* Bind to GPIO 0 and PWM0 */
    gpio0_dev = device_get_binding(DT_LABEL(GPIO0_NID));
    if (gpio0_dev == NULL) {
        printk("Error: Failed to bind to GPIO0\n\r");        
	return;
    }
    else {
        printk("Bind to GPIO0 successfull \n\r");        
    }
    
    pwm0_dev = device_get_binding(DT_LABEL(PWM0_NID));
    if (pwm0_dev == NULL) {
	printk("Error: Failed to bind to PWM0\n r");
	return;
    }
    else  {
        printk("Bind to PWM0 successful\n\r");            
    }

    printk("Thread C init (sporadic, waits on a semaphore by task A)\n");  
    while(1) 
    {
           k_sem_take(&sem_cd, K_FOREVER); 
                                   
	   /* Achar o valor de luz ambiente com o sistema desligado */   
           if(flag<15)
           {
                to_add=(uint16_t)(1000*bc*((float)3/1023));
                total=total+to_add;
                tensaoambiente=total/15;
                flag++;
           }
           else
           {
                 if(cd == 1) mode = 1;	/* modo manual */		
                 if(cd == 2) mode = 2;  /* modo automatico */		
                 			
                 if(mode == 1)/* modo manual */
                 {   
                      printk("\n\n\n");              
                      printk("***Modo Manual***      | Tensao no sensor => %4u mv \n"
                             " Butao 2 => Automatic  | Tensao ambiente => %4u mv  \n"
                             " Butao 3 => +10 Dc     | PWM DC value set to %u%     \n"
                             " Butao 4 => -10 DC     |                            \n",tensaoMV,tensaoambiente,duty);
                                        
                      if(cd == 3)  duty = duty + 10;/* incrementar duty */
                      if(cd == 4)  duty = duty - 10;/* decrementar duty */
                      if (duty > 100) duty = 100;       
                      if (duty < 0) duty = 0;
            
                      tensaoMV=(uint16_t)(1000*bc*((float)3/1023));
                      lux=tensaoMV/(0.0000008*10000*1000);
                      printk(" LUX = %dlux\n",lux);                         
                      flag1=0;
                 } 
                     
                 else  /* Modo automatico */
                 {
                      if(flag1==0)/* Configurar o calendario inicialmente */
                      {                   
                         day=1;
                         printk("Que horas sao?\n");
                         printk("-------------------------------------------------\n");

                         /* inserir dia */
                         printk("Dia -> ");
                         c = console_getchar();
                         printk("%d",c-48);
                         day1=(int16_t)(c-48)*10;
                         c = console_getchar();
                         printk("%d",c-48);
                         day2=(int16_t)(c-48);
                         day=day1+day2;
                         printk("\n");

                         /* inserir horas */
                         printk("Hora -> ");
                         c = console_getchar();
                         printk("%d",c-48);
                         hora1=(int16_t)(c-48)*10;
                         c = console_getchar();
                         printk("%d",c-48);
                         hora2=(int16_t)(c-48);
                         hora=hora1+hora2;
                         printk("\n");

                         /* inserir minutos */
                         printk("Minuto -> ");
                         c = console_getchar();
                         printk("%d",c-48);
                         min1=(int16_t)(c-48)*10;
                         c = console_getchar();
                         printk("%d",c-48);
                         min2=(int16_t)(c-48);
                         min=min1+min2;
                         printk("\n\n");
                                 
                         printk("Selecione os Dias em que o led deve estar Ligado . Enter quando terminar\n");
                         printk("-------------------------------------------------\n");
                   
                         for(int i=0;i< arrLen;i++)
                         {                   
                             c = console_getchar();
                             ref1=(int16_t)(c-48)*10;
                                  
                            if(c-48 != -35)
                            {                                  
                               printk("%d",c-48);
                               c = console_getchar();                  
                               ref2=(int16_t)(c-48);
                               printk("%d",c-48);
                               printk(", ");
                               dayOn[i]=ref1+ref2;                    
                            }
                            else
                            {
                               printk("\n");
                               break;
                            }
                         }/*fecha for */ 
                         printk("Selecione as horas em que o led deve estar Ligado . Enter quando terminar\n");
                         printk("-------------------------------------------------\n");
                   
                         for(int i=0;i< arrLen;i++)
                         {                   
                             c = console_getchar();
                             ref1=(int16_t)(c-48)*10;
                                  
                             if(c-48 != -35)
                             {                  
                                 printk("%d",c-48);
                                 c = console_getchar();                  
                                 ref2=(int16_t)(c-48);
                                 printk("%d",c-48);
                                 printk(", ");
                                 horasOn[i]=ref1+ref2;                  
                             }                   
                             else
                             {
                                printk("\n");
                                break;
                             }
                         }/*fecha for */ 

                          printk("Inserir valor de referencia---> \n");
                   
                          c = console_getchar();
                          ref1=(int16_t)(c-48)*1000;
                          printk("%d",c-48);
                          c = console_getchar();
                          ref2=(int16_t)(c-48)*100;
                          printk("%d",c-48);
                          c = console_getchar();
                          ref3=(int16_t)(c-48)*10;
                          printk("%d",c-48);
                          c = console_getchar();
                          ref4=(int16_t)(c-48);
                          printk("%d",ref4);
                   
                          ref=ref1+ref2+ref3+ref4;                                  
                          flag1=1; 

                          } /* Configura玢o do calendario concluida */
            
                          /* Inicio do modo automatico */
                          clkPrint();        
                          printk("\n\n\n");
                          printk("**Modo Automatico*** |  (REF --> UP/DOWN)          | Butao 1 => Manual  \n"
                                 "******************** |  Tensao ambiente => %4u mv  | Butao 3 => Ref+    \n"
                                 " %ddia  %dh:%dm:%ds  |  Tensao no sensor => %4u mv | Butao 4 => Ref-    \n"
                                 "******************** ******************************************************\n"  
                                 " (PID) ref = %d mv   |       Duty = %d %           | (PID) integ = %d mv\n"  
                                 " (PID) erro = %d mv  |  (PID) saidaPI = %d mv      | (PID) diff = %d mv \n"
                                 "  LUX = %dlx\n",tensaoambiente,day,hora,min,seg,tensaoMV,ref,duty,integ,erro,saidaPI,diff,lux);                  
            
                                                                                                      
                         //PID CONTROLER
                         Ti=1.5;
                         Td=0.5;
                         kp=1.85;

                         if(cd == 3)  ref = ref + 300;                         
                         else if(cd == 4)  ref = ref - 300;
                                  
                         tensaoMV=(uint16_t)(1000*bc*((float)3/1023));
                         lux=tensaoMV/(0.0000008*10000*1000);  /* Equacao da reta do sensor */
                              
                         erro2 = erro;
                         erro = ref - tensaoMV;

                         integ = integ + erro2; 
                         diff = (erro2-erro)/0.1;  /* periodo de amostragem = 0.1 */           
              
                         if(integ > 3000) integ = 3000;

                         else if(diff < -5000) diff = -5000;

                         if(diff > 5000) diff = 5000;

                         else if(integ < -2000) integ = -2000;

                         saidaPI = kp * erro + (1 / Ti) * integ + Td*diff;                
                          
                         for (int i = 0; i < arrLen; i++)
                         {
                              if (dayOn[i] == day)
                              {
                                if(horasOn[i]== hora)
                                {
                                    duty = (uint16_t)100 - (saidaPI) / 30;
             
                                    if (duty > 98)  duty = 98;
             
                                    else if (duty < 0) duty = 0; 
                    
                                }                    
                                else
                                {
                                   duty=100; 
                                   tensaoambiente=(uint16_t)(1000*bc*((float)3/1023));
                                   erro=0,diff=0,integ=0,saidaPI=0;
                                }
                              }
                         } /*fecha for */                                                                             
                    } /* modo automatico concluido */ 
       } /* primeiras 10 amostras concluido */
       
       ret = pwm_pin_set_usec(pwm0_dev, BOARDLED_PIN,pwmPeriod_us,(unsigned int)((pwmPeriod_us*duty)/100), PWM_POLARITY_NORMAL);
       cd = 0;  /* reset valor do botao */      
       
  }//fecha while
}//fecha thread
```

## src/PWM.h
```c
/** \file PWM.h
* \brief PWM Output
* 
* Process the data of tread B using pwm
* Output: pwm signal applied to one of the DevKit leds.
*
* \author Goncalo Moniz, Joao Oliveira, Diogo Leao
* \date 31-5-2022
* \bug There are no bugs
*/

#include <zephyr.h>
#include <device.h>
#include <drivers/gpio.h>
#include <drivers/adc.h>
#include <string.h>
#include <devicetree.h>
#include <sys/printk.h>
#include <sys/__assert.h>
#include <timing/timing.h>
#include <stdio.h>
#include <sys/printk.h>
#include <hal/nrf_saadc.h>

#ifndef _PWM_H
#define _PWM_H

//---------------PWM CONFIG

#define BOARDLED_PIN DT_PROP(PWM0_NID, ch0_pin)
#include <drivers/pwm.h>
/* Refer to dts file */
#define GPIO0_NID DT_NODELABEL(gpio0) 
#define PWM0_NID DT_NODELABEL(pwm0) 

extern uint16_t cd;
extern uint16_t bc;
extern struct k_sem sem_cd;

/**Thread C
* 
* Thread for the PWM
* \author Goncalo Moniz, Joao Oliveira, Diogo Leao
* \param[in,out] 
*void
*void
* \return void
* \date 31-5-2022
*/
void thread_C_code(void *argA , void *argB, void *argC);


#endif
```

## src/placa.c
```c
#include "placa.h"

static struct gpio_callback button1_cb_data;
static struct gpio_callback button2_cb_data;
static struct gpio_callback button3_cb_data;
static struct gpio_callback button4_cb_data;

volatile int dcToggleFlag = 0;


void button1_pressed(const struct device *dev, struct gpio_callback *cb,
		    uint32_t pins)
{
        dcToggleFlag=1;
}

void button2_pressed(const struct device *dev, struct gpio_callback *cb,
		    uint32_t pins)
{
        dcToggleFlag=2;
}
void button3_pressed(const struct device *dev, struct gpio_callback *cb,
		    uint32_t pins)
{
        dcToggleFlag=3;
}
void button4_pressed(const struct device *dev, struct gpio_callback *cb,
		    uint32_t pins)
{
        dcToggleFlag=4;
}

void InitConfig(void){
      /* Local vars */    
    const struct device *gpio0_dev;         /* Pointer to GPIO device structure */
    int ret=0;                              /* Generic return value variable */


    /* Bind to GPIO 0 */
    gpio0_dev = device_get_binding(DT_LABEL(GPIO0_NID));
    if (gpio0_dev == NULL) {
        printk("Failed to bind to GPIO0\n\r");        
	return;
    }
    else {
        printk("Bind to GPIO0 successfull \n\n\n\n\n\n\n\n\r");        
    }
    
    ret = gpio_pin_configure(gpio0_dev, button1, GPIO_INPUT | GPIO_PULL_UP);
    if (ret < 0) {
        printk("gpio_pin_configure() failed with error %d\n\r", ret);        
	return;
    }
   ret = gpio_pin_configure(gpio0_dev, button2, GPIO_INPUT | GPIO_PULL_UP);
    if (ret < 0) {
        printk("gpio_pin_configure() failed with error %d\n\r", ret);        
	return;
    }
    ret = gpio_pin_configure(gpio0_dev, button3, GPIO_INPUT | GPIO_PULL_UP);
    if (ret < 0) {
        printk("gpio_pin_configure() failed with error %d\n\r", ret);        
	return;
    }
    ret = gpio_pin_configure(gpio0_dev, button4, GPIO_INPUT | GPIO_PULL_UP);
    if (ret < 0) {
        printk("gpio_pin_configure() failed with error %d\n\r", ret);        
	return;
    }

    
    	ret = gpio_pin_interrupt_configure(gpio0_dev,button1,GPIO_INT_EDGE_TO_ACTIVE);
	if (ret != 0) {
		return;
	}
    	ret = gpio_pin_interrupt_configure(gpio0_dev,button2,GPIO_INT_EDGE_TO_ACTIVE);
	if (ret != 0) {
		return;
	}
    	ret = gpio_pin_interrupt_configure(gpio0_dev,button3,GPIO_INT_EDGE_TO_ACTIVE);
	if (ret != 0) {
		return;
	}
     	ret = gpio_pin_interrupt_configure(gpio0_dev,button4,GPIO_INT_EDGE_TO_ACTIVE);
	if (ret != 0) {
		return;
	}

	gpio_init_callback(&button1_cb_data, button1_pressed, BIT(button1));
	gpio_add_callback(gpio0_dev, &button1_cb_data);

	gpio_init_callback(&button2_cb_data, button2_pressed, BIT(button2));
	gpio_add_callback(gpio0_dev, &button2_cb_data);

        gpio_init_callback(&button3_cb_data, button3_pressed, BIT(button3));
	gpio_add_callback(gpio0_dev, &button3_cb_data);

        gpio_init_callback(&button4_cb_data, button4_pressed, BIT(button4));

	gpio_add_callback(gpio0_dev, &button4_cb_data);    
      
        return;

}

void thread_D_code(void *argA , void *argB, void *argC)
{
	InitConfig();
	int64_t fin_time=0, release_time=0;  
	release_time = k_uptime_get() + SAMP_PERIOD_MS;
   /* Timing variables to control task periodicity */    
	while(true)
    {
    	if(dcToggleFlag == 0)
    	{
    		k_sem_give(&sem_cd);
    	}
    	else
    	{
    		k_sem_give(&sem_cd);
    		cd = dcToggleFlag;
    		dcToggleFlag = 0;
    	}
    	/* Wait for next release instant */ 
        fin_time = k_uptime_get();
        if( fin_time < release_time) 
        {
            k_msleep(release_time - fin_time);
            release_time += SAMP_PERIOD_MS;
        }

        /* Stop timing functions */
        timing_stop();

    }
}
```

## src/placa.h
```c
/** @file Placa.h
 * @brief Variaveis e programação da placa
 *
 * Este modulo inicia as portas da placa que queremos usar e verifica
 * se não ocorreu nenhum erro
 * 
 * 
 * @author Goncalo Moniz, João Oliveira, Diogo Leão
 * @bug No known bugs.
 */

#include <zephyr.h>
#include <device.h>
#include <devicetree.h>
#include <drivers/gpio.h>
#include <sys/printk.h>
#include <sys/__assert.h>
#include <string.h>
#include <timing/timing.h>
#include <stdio.h>
#include <string.h>

#ifndef _PLACA_H
#define _PLACA_H

/* Refer to dts file */
#define GPIO0_NID DT_NODELABEL(gpio0) 

#define button1 0xb
#define button2 0xc
#define button3 0x18
#define button4 0x19

#define SAMP_PERIOD_MS 100

extern volatile int dcToggleFlag;
extern  uint8_t c;
extern uint16_t cd;
extern struct k_sem sem_cd;

void button1_pressed(const struct device *dev, struct gpio_callback *cb, uint32_t pins);
void button2_pressed(const struct device *dev, struct gpio_callback *cb, uint32_t pins);
void button3_pressed(const struct device *dev, struct gpio_callback *cb, uint32_t pins);
void button4_pressed(const struct device *dev, struct gpio_callback *cb, uint32_t pins);

/**
 * @brief Inicia o Modulo
 * 
 * Esta função inicializa o modulo
 */
void InitConfig(void);

void thread_D_code(void *argA , void *argB, void *argC);

#endif
```

## src/uart.h
```c
#include <zephyr.h>
#include <device.h>
#include <drivers/gpio.h>
#include <drivers/adc.h>
#include <string.h>
#include <devicetree.h>
#include <sys/printk.h>
#include <sys/__assert.h>
#include <timing/timing.h>
#include <stdio.h>
#include <sys/printk.h>
#include <hal/nrf_saadc.h>



#define MAIN_SLEEP_TIME_MS 10 /* Time between main() activations */ 

#define FATAL_ERR -1 /* Fatal error return code, app terminates */

#define UART_NID DT_NODELABEL(uart0)    /* UART Node label, see dts */
#define RXBUF_SIZE 60                   /* RX buffer size */
#define TXBUF_SIZE 60                   /* TX buffer size */
#define RX_TIMEOUT 1000                  /* Inactivity period after the instant when last char was received that triggers an rx event (in us) */



/* UART callback function prototype */
static void uart_cb(const struct device *dev, struct uart_event *evt, void *user_data);

/* UART callback implementation */
/* Note that callback functions are executed in the scope of interrupt handlers. */
/* They run asynchronously after hardware/software interrupts and have a higher priority than all threads */
/* Should be kept as short and simple as possible. Heavier processing should be deferred to a task with suitable priority*/
```
